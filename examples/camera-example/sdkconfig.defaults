## examples/camera-example/sdkconfig.defaults
```kconfig
# Rust often needs a bit of an extra main task stack size compared to C (the default is 3K)
CONFIG_ESP_MAIN_TASK_STACK_SIZE=8000

CONFIG_ESP32S3_SPIRAM_SUPPORT=y
CONFIG_SPIRAM_MODE_OCT=y
CONFIG_LWIP_LOCAL_HOSTNAME="esp-cam"
CONFIG_PARTITION_TABLE_SINGLE_APP_LARGE=y
```
